## build/Kconfig/boards/Kconfig.xiao_ble
```kconfig
# Load board Kconfig descriptions.
osource "C:/Users/Brian/pouch-node-ws/zephyr/boards/seeed/xiao_ble/Kconfig.xiao_ble"
```

## build/ble_gatt/Kconfig/Kconfig.modules
```kconfig
menu "pouch (C:/Users/Brian/pouch-node-ws/pouch)"
osource "C:/Users/Brian/pouch-node-ws/pouch/Kconfig"
config ZEPHYR_POUCH_MODULE
	bool
	default y
endmenu
menu "nrf (C:/Users/Brian/pouch-node-ws/nrf)"
osource "C:/Users/Brian/pouch-node-ws/nrf/Kconfig.nrf"
config ZEPHYR_NRF_MODULE
	bool
	default y
endmenu
menu "mcuboot (C:/Users/Brian/pouch-node-ws/bootloader/mcuboot)"
osource "$(ZEPHYR_MCUBOOT_KCONFIG)"
config ZEPHYR_MCUBOOT_MODULE
	bool
	default y
endmenu
menu "mbedtls (C:/Users/Brian/pouch-node-ws/modules/crypto/mbedtls)"
osource "$(ZEPHYR_MBEDTLS_KCONFIG)"
config ZEPHYR_MBEDTLS_MODULE
	bool
	default y
endmenu
menu "oberon-psa-crypto (C:/Users/Brian/pouch-node-ws/modules/crypto/oberon-psa-crypto)"
osource "C:/Users/Brian/pouch-node-ws/modules/crypto/oberon-psa-crypto/Kconfig.oberon_psa_crypto"
config ZEPHYR_OBERON_PSA_CRYPTO_MODULE
	bool
	default y
endmenu
menu "trusted-firmware-m (C:/Users/Brian/pouch-node-ws/modules/tee/tf-m/trusted-firmware-m)"
osource "$(ZEPHYR_TRUSTED_FIRMWARE_M_KCONFIG)"
config ZEPHYR_TRUSTED_FIRMWARE_M_MODULE
	bool
	default y
endmenu
menu "cmsis_6 (C:/Users/Brian/pouch-node-ws/modules/hal/cmsis_6)"
osource "$(ZEPHYR_CMSIS_6_KCONFIG)"
config ZEPHYR_CMSIS_6_MODULE
	bool
	default y
endmenu
menu "hal_nordic (C:/Users/Brian/pouch-node-ws/modules/hal/nordic)"
osource "$(ZEPHYR_HAL_NORDIC_KCONFIG)"
config ZEPHYR_HAL_NORDIC_MODULE
	bool
	default y

config ZEPHYR_HAL_NORDIC_MODULE_BLOBS
	bool
endmenu
menu "littlefs (C:/Users/Brian/pouch-node-ws/modules/fs/littlefs)"
osource "$(ZEPHYR_LITTLEFS_KCONFIG)"
config ZEPHYR_LITTLEFS_MODULE
	bool
	default y
endmenu
menu "segger (C:/Users/Brian/pouch-node-ws/modules/debug/segger)"
osource "$(ZEPHYR_SEGGER_KCONFIG)"
config ZEPHYR_SEGGER_MODULE
	bool
	default y
endmenu
menu "zcbor (C:/Users/Brian/pouch-node-ws/modules/lib/zcbor)"
osource "$(ZEPHYR_ZCBOR_KCONFIG)"
config ZEPHYR_ZCBOR_MODULE
	bool
	default y
endmenu
menu "nrfxlib (C:/Users/Brian/pouch-node-ws/nrfxlib)"
osource "C:/Users/Brian/pouch-node-ws/nrfxlib/Kconfig.nrfxlib"
config ZEPHYR_NRFXLIB_MODULE
	bool
	default y
endmenu
```

## build/ble_gatt/Kconfig/arch/Kconfig
```kconfig
# Load Zephyr Arch Kconfig descriptions.
osource "C:/Users/Brian/pouch-node-ws/zephyr/arch/rx/Kconfig"
osource "C:/Users/Brian/pouch-node-ws/zephyr/arch/x86/Kconfig"
osource "C:/Users/Brian/pouch-node-ws/zephyr/arch/xtensa/Kconfig"
osource "C:/Users/Brian/pouch-node-ws/zephyr/arch/sparc/Kconfig"
osource "C:/Users/Brian/pouch-node-ws/zephyr/arch/riscv/Kconfig"
osource "C:/Users/Brian/pouch-node-ws/zephyr/arch/posix/Kconfig"
osource "C:/Users/Brian/pouch-node-ws/zephyr/arch/mips/Kconfig"
osource "C:/Users/Brian/pouch-node-ws/zephyr/arch/arm64/Kconfig"
osource "C:/Users/Brian/pouch-node-ws/zephyr/arch/arm/Kconfig"
osource "C:/Users/Brian/pouch-node-ws/zephyr/arch/arc/Kconfig"
```

## build/ble_gatt/Kconfig/boards/Kconfig.defconfig
```kconfig
# Load Zephyr board defconfig descriptions.
osource "C:/Users/Brian/pouch-node-ws/zephyr/boards/seeed/xiao_ble/Kconfig.defconfig"
```

## build/ble_gatt/Kconfig/soc/Kconfig
```kconfig
# Load Zephyr SoC Kconfig descriptions.
osource "C:/Users/Brian/pouch-node-ws/zephyr/soc/xlnx/zynqmp/Kconfig"
osource "C:/Users/Brian/pouch-node-ws/zephyr/soc/xlnx/zynq7000/Kconfig"
osource "C:/Users/Brian/pouch-node-ws/zephyr/soc/xlnx/versalnet/Kconfig"
osource "C:/Users/Brian/pouch-node-ws/zephyr/soc/xlnx/versal2/Kconfig"
osource "C:/Users/Brian/pouch-node-ws/zephyr/soc/xen/Kconfig"
osource "C:/Users/Brian/pouch-node-ws/zephyr/soc/wch/ch32v/Kconfig"
osource "C:/Users/Brian/pouch-node-ws/zephyr/soc/ti/simplelink/Kconfig"
osource "C:/Users/Brian/pouch-node-ws/zephyr/soc/ti/mspm0/Kconfig"
osource "C:/Users/Brian/pouch-node-ws/zephyr/soc/ti/lm3s6965/Kconfig"
osource "C:/Users/Brian/pouch-node-ws/zephyr/soc/ti/k3/Kconfig"
osource "C:/Users/Brian/pouch-node-ws/zephyr/soc/telink/tlsr/Kconfig"
osource "C:/Users/Brian/pouch-node-ws/zephyr/soc/starfive/jh71xx/Kconfig"
osource "C:/Users/Brian/pouch-node-ws/zephyr/soc/st/stm32/Kconfig"
osource "C:/Users/Brian/pouch-node-ws/zephyr/soc/snps/qemu_arc/Kconfig"
osource "C:/Users/Brian/pouch-node-ws/zephyr/soc/snps/nsim/arc_v/Kconfig"
osource "C:/Users/Brian/pouch-node-ws/zephyr/soc/snps/nsim/arc_classic/Kconfig"
osource "C:/Users/Brian/pouch-node-ws/zephyr/soc/snps/hsdk4xd/Kconfig"
osource "C:/Users/Brian/pouch-node-ws/zephyr/soc/snps/hsdk/Kconfig"
osource "C:/Users/Brian/pouch-node-ws/zephyr/soc/snps/emsk/Kconfig"
osource "C:/Users/Brian/pouch-node-ws/zephyr/soc/snps/emsdp/Kconfig"
osource "C:/Users/Brian/pouch-node-ws/zephyr/soc/snps/arc_iot/Kconfig"
osource "C:/Users/Brian/pouch-node-ws/zephyr/soc/silabs/Kconfig"
osource "C:/Users/Brian/pouch-node-ws/zephyr/soc/sifive/sifive_freedom/Kconfig"
osource "C:/Users/Brian/pouch-node-ws/zephyr/soc/sensry/Kconfig"
osource "C:/Users/Brian/pouch-node-ws/zephyr/soc/rockchip/Kconfig"
osource "C:/Users/Brian/pouch-node-ws/zephyr/soc/renode/riscv_virtual/Kconfig"
osource "C:/Users/Brian/pouch-node-ws/zephyr/soc/renode/cortex_r8_virtual/Kconfig"
osource "C:/Users/Brian/pouch-node-ws/zephyr/soc/renesas/smartbond/Kconfig"
osource "C:/Users/Brian/pouch-node-ws/zephyr/soc/renesas/rz/Kconfig"
osource "C:/Users/Brian/pouch-node-ws/zephyr/soc/renesas/rx/Kconfig"
osource "C:/Users/Brian/pouch-node-ws/zephyr/soc/renesas/rcar/Kconfig"
osource "C:/Users/Brian/pouch-node-ws/zephyr/soc/renesas/ra/Kconfig"
osource "C:/Users/Brian/pouch-node-ws/zephyr/soc/realtek/ec/Kconfig"
osource "C:/Users/Brian/pouch-node-ws/zephyr/soc/raspberrypi/rpi_pico/Kconfig"
osource "C:/Users/Brian/pouch-node-ws/zephyr/soc/quicklogic/eos_s3/Kconfig"
osource "C:/Users/Brian/pouch-node-ws/zephyr/soc/qemu/virt_riscv/Kconfig"
osource "C:/Users/Brian/pouch-node-ws/zephyr/soc/qemu/malta/Kconfig"
osource "C:/Users/Brian/pouch-node-ws/zephyr/soc/openisa/rv32m1/Kconfig"
osource "C:/Users/Brian/pouch-node-ws/zephyr/soc/openhwgroup/cva6/Kconfig"
osource "C:/Users/Brian/pouch-node-ws/zephyr/soc/oct/osd32mp15x/Kconfig"
osource "C:/Users/Brian/pouch-node-ws/zephyr/soc/nxp/s32/Kconfig"
osource "C:/Users/Brian/pouch-node-ws/zephyr/soc/nxp/rw/Kconfig"
osource "C:/Users/Brian/pouch-node-ws/zephyr/soc/nxp/mcx/Kconfig"
osource "C:/Users/Brian/pouch-node-ws/zephyr/soc/nxp/lpc/Kconfig"
osource "C:/Users/Brian/pouch-node-ws/zephyr/soc/nxp/layerscape/Kconfig"
osource "C:/Users/Brian/pouch-node-ws/zephyr/soc/nxp/kinetis/Kconfig"
osource "C:/Users/Brian/pouch-node-ws/zephyr/soc/nxp/imxrt/Kconfig"
osource "C:/Users/Brian/pouch-node-ws/zephyr/soc/nxp/imx/Kconfig"
osource "C:/Users/Brian/pouch-node-ws/zephyr/soc/nuvoton/numicro/Kconfig"
osource "C:/Users/Brian/pouch-node-ws/zephyr/soc/nuvoton/numaker/Kconfig"
osource "C:/Users/Brian/pouch-node-ws/zephyr/soc/nuvoton/npcx/Kconfig"
osource "C:/Users/Brian/pouch-node-ws/zephyr/soc/nuvoton/npcm/Kconfig"
osource "C:/Users/Brian/pouch-node-ws/zephyr/soc/nordic/Kconfig"
osource "C:/Users/Brian/pouch-node-ws/zephyr/soc/neorv32/Kconfig"
osource "C:/Users/Brian/pouch-node-ws/zephyr/soc/native/inf_clock/Kconfig"
osource "C:/Users/Brian/pouch-node-ws/zephyr/soc/microchip/sam/Kconfig"
osource "C:/Users/Brian/pouch-node-ws/zephyr/soc/microchip/miv/Kconfig"
osource "C:/Users/Brian/pouch-node-ws/zephyr/soc/microchip/mec/Kconfig"
osource "C:/Users/Brian/pouch-node-ws/zephyr/soc/mediatek/mt8xxx/Kconfig"
osource "C:/Users/Brian/pouch-node-ws/zephyr/soc/lowrisc/opentitan/Kconfig"
osource "C:/Users/Brian/pouch-node-ws/zephyr/soc/litex/litex_vexriscv/Kconfig"
osource "C:/Users/Brian/pouch-node-ws/zephyr/soc/ite/ec/Kconfig"
osource "C:/Users/Brian/pouch-node-ws/zephyr/soc/intel/raptor_lake/Kconfig"
osource "C:/Users/Brian/pouch-node-ws/zephyr/soc/intel/lakemont/Kconfig"
osource "C:/Users/Brian/pouch-node-ws/zephyr/soc/intel/intel_socfpga_std/Kconfig"
osource "C:/Users/Brian/pouch-node-ws/zephyr/soc/intel/intel_socfpga/Kconfig"
osource "C:/Users/Brian/pouch-node-ws/zephyr/soc/intel/intel_niosv/Kconfig"
osource "C:/Users/Brian/pouch-node-ws/zephyr/soc/intel/intel_ish/Kconfig"
osource "C:/Users/Brian/pouch-node-ws/zephyr/soc/intel/intel_adsp/Kconfig"
osource "C:/Users/Brian/pouch-node-ws/zephyr/soc/intel/elkhart_lake/Kconfig"
osource "C:/Users/Brian/pouch-node-ws/zephyr/soc/intel/atom/Kconfig"
osource "C:/Users/Brian/pouch-node-ws/zephyr/soc/intel/apollo_lake/Kconfig"
osource "C:/Users/Brian/pouch-node-ws/zephyr/soc/intel/alder_lake/Kconfig"
osource "C:/Users/Brian/pouch-node-ws/zephyr/soc/infineon/cat3/Kconfig"
osource "C:/Users/Brian/pouch-node-ws/zephyr/soc/infineon/cat1c/Kconfig"
osource "C:/Users/Brian/pouch-node-ws/zephyr/soc/infineon/cat1b/Kconfig"
osource "C:/Users/Brian/pouch-node-ws/zephyr/soc/infineon/cat1a/Kconfig"
osource "C:/Users/Brian/pouch-node-ws/zephyr/soc/gd/gd32/Kconfig"
osource "C:/Users/Brian/pouch-node-ws/zephyr/soc/gaisler/leon3/Kconfig"
osource "C:/Users/Brian/pouch-node-ws/zephyr/soc/gaisler/gr716a/Kconfig"
osource "C:/Users/Brian/pouch-node-ws/zephyr/soc/espressif/Kconfig"
osource "C:/Users/Brian/pouch-node-ws/zephyr/soc/ene/kb1200/Kconfig"
osource "C:/Users/Brian/pouch-node-ws/zephyr/soc/efinix/sapphire/Kconfig"
osource "C:/Users/Brian/pouch-node-ws/zephyr/soc/cdns/xtensa_sample_controller/Kconfig"
osource "C:/Users/Brian/pouch-node-ws/zephyr/soc/cdns/sample_controller32/Kconfig"
osource "C:/Users/Brian/pouch-node-ws/zephyr/soc/cdns/dc233c/Kconfig"
osource "C:/Users/Brian/pouch-node-ws/zephyr/soc/brcm/bcmvk/Kconfig"
osource "C:/Users/Brian/pouch-node-ws/zephyr/soc/brcm/bcm2712/Kconfig"
osource "C:/Users/Brian/pouch-node-ws/zephyr/soc/brcm/bcm2711/Kconfig"
osource "C:/Users/Brian/pouch-node-ws/zephyr/soc/bflb/Kconfig"
osource "C:/Users/Brian/pouch-node-ws/zephyr/soc/atmel/sam0/Kconfig"
osource "C:/Users/Brian/pouch-node-ws/zephyr/soc/atmel/sam/Kconfig"
osource "C:/Users/Brian/pouch-node-ws/zephyr/soc/aspeed/Kconfig"
osource "C:/Users/Brian/pouch-node-ws/zephyr/soc/arm/Kconfig"
osource "C:/Users/Brian/pouch-node-ws/zephyr/soc/arm/beetle/Kconfig"
osource "C:/Users/Brian/pouch-node-ws/zephyr/soc/antmicro/myra/Kconfig"
osource "C:/Users/Brian/pouch-node-ws/zephyr/soc/andestech/Kconfig"
osource "C:/Users/Brian/pouch-node-ws/zephyr/soc/amd/acp_6_0/Kconfig"
osource "C:/Users/Brian/pouch-node-ws/zephyr/soc/ambiq/Kconfig"
osource "C:/Users/Brian/pouch-node-ws/zephyr/soc/aesc/Kconfig"
osource "C:/Users/Brian/pouch-node-ws/zephyr/soc/adi/max32/Kconfig"
osource "C:/Users/Brian/pouch-node-ws/nrf/soc/sercomm/nrf91/Kconfig"
osource "C:/Users/Brian/pouch-node-ws/nrf/soc/nordic/Kconfig"
```

## build/mcuboot/Kconfig/Kconfig.sysbuild.modules
```kconfig
config ZEPHYR_POUCH_MODULE
   bool
   default y
menu "nrf (C:/Users/Brian/pouch-node-ws/nrf)"
osource "C:/Users/Brian/pouch-node-ws/nrf/sysbuild/Kconfig.sysbuild"
config ZEPHYR_NRF_MODULE
	bool
	default y
endmenu
config ZEPHYR_MCUBOOT_MODULE
   bool
   default y
config ZEPHYR_MBEDTLS_MODULE
   bool
   default y
config ZEPHYR_OBERON_PSA_CRYPTO_MODULE
   bool
   default y
config ZEPHYR_TRUSTED_FIRMWARE_M_MODULE
   bool
   default y
config ZEPHYR_CMSIS_6_MODULE
   bool
   default y
config ZEPHYR_HAL_NORDIC_MODULE
   bool
   default y
config ZEPHYR_LITTLEFS_MODULE
   bool
   default y
config ZEPHYR_SEGGER_MODULE
   bool
   default y
config ZEPHYR_ZCBOR_MODULE
   bool
   default y
config ZEPHYR_NRFXLIB_MODULE
   bool
   default y
```

## build/mcuboot/Kconfig/boards/Kconfig
```kconfig
# Load Zephyr board Kconfig descriptions.
osource "C:/Users/Brian/pouch-node-ws/zephyr/boards/seeed/xiao_ble/Kconfig"
```
